## components/diag/Kconfig
```kconfig
menu "Diagnostics Configuration"

    config DIAG_ENABLE
        bool "Enable runtime diagnostics"
        default y
        help
            Periodically collect memory / task stats.

    config DIAG_INTERVAL_SEC
        int "Snapshot interval (seconds)"
        default 30
        depends on DIAG_ENABLE
        help
            Period between automatic memory snapshots.

endmenu
```

## components/drv_audio/Kconfig
```kconfig
menu "I2S Audio Data Path Driver Configuration"

    config DRV_AUDIO_ENABLE
        bool "Enable I2S full-duplex audio driver"
        default y
        help
            Compile the I2S standard-mode full-duplex driver (16kHz/16bit/mono).
            I2S pins are defined in board.h (BOARD_I2S_xxx).

endmenu
```

## components/drv_camera/Kconfig
```kconfig
menu "Camera Driver Configuration"

    config DRV_CAMERA_ENABLE
        bool "Enable camera driver (DVP)"
        default n
        help
            Compile the DVP camera driver into firmware.
            Requires PSRAM. Set to 'y' after selecting a camera sensor.

    config DRV_CAMERA_SENSOR
        string "Camera sensor model"
        default "UNDEFINED"
        depends on DRV_CAMERA_ENABLE
        help
            Camera sensor IC, e.g. OV2640, OV5640.

endmenu
```

## components/drv_display/Kconfig
```kconfig
menu "Display Driver Configuration"

    config DRV_DISPLAY_ENABLE
        bool "Enable display driver"
        default n
        help
            Compile the display driver into firmware.
            Set to 'y' after selecting a display IC (OLED / LCD / E-ink).

    config DRV_DISPLAY_TYPE
        string "Display IC model"
        default "UNDEFINED"
        depends on DRV_DISPLAY_ENABLE
        help
            Display controller IC, e.g. SSD1306, ST7789, ILI9341.

endmenu
```

## components/drv_es8388/Kconfig
```kconfig
menu "ES8388 Audio Codec Driver Configuration"

    config DRV_ES8388_ENABLE
        bool "Enable ES8388 audio codec driver"
        default y
        help
            Compile the ES8388 codec register-configuration driver.
            Codec address and I2C bus are defined in board.h.

endmenu
```

## components/drv_led/Kconfig
```kconfig
menu "Status LED Driver Configuration"

    config DRV_LED_ENABLE
        bool "Enable status LED driver"
        default y
        help
            Compile the GPIO status LED driver into firmware.
            LED pin is defined in board.h (BOARD_LED_STATUS_GPIO).

    config DRV_LED_ACTIVE_LOW
        bool "LED is active-low (LED cathode connected to GPIO)"
        default y
        depends on DRV_LED_ENABLE
        help
            Set this when the LED anode is tied to VCC through a resistor
            and the GPIO sinks current (output low = LED on), as on this board.

endmenu
```

## components/drv_servo_pwm/Kconfig
```kconfig
menu "Servo PWM Driver Configuration"

    config DRV_SERVO_PWM_ENABLE
        bool "Enable PWM servo driver (MCPWM)"
        default y
        help
            Compile the PWM servo driver into firmware. Disable if no servo is used.

    config DRV_SERVO_PWM_PWM_FREQ_HZ
        int "PWM frequency (Hz)"
        default 50
        depends on DRV_SERVO_PWM_ENABLE
        help
            Standard analog servos use 50 Hz (20 ms period).

    config DRV_SERVO_PWM_MIN_PULSE_US
        int "Minimum pulse width (us, 0 deg)"
        default 500
        depends on DRV_SERVO_PWM_ENABLE
        help
            Pulse width corresponding to 0 degree. Typical: 500-1000 us.

    config DRV_SERVO_PWM_MAX_PULSE_US
        int "Maximum pulse width (us, 180 deg)"
        default 2500
        depends on DRV_SERVO_PWM_ENABLE
        help
            Pulse width corresponding to 180 degree. Typical: 2000-2500 us.

endmenu
```

## components/drv_xl9555/Kconfig
```kconfig
menu "XL9555 IO Expander Driver Configuration"

    config DRV_XL9555_ENABLE
        bool "Enable XL9555 IO expander driver"
        default y
        help
            Compile the XL9555 (PCA9555 compatible) IO expander driver.
            Used for onboard KEY0~3 scan, beeper and speaker PA enable.
            I2C bus is managed by board layer (BOARD_I2C0_xxx in board.h).

    config DRV_XL9555_SCAN_PERIOD_MS
        int "Key scan period (ms)"
        default 20
        range 5 200
        depends on DRV_XL9555_ENABLE
        help
            Period of the key scan task. 20ms gives good debounce
            with 2 consecutive confirmations.

endmenu
```

## components/evt_log/Kconfig
```kconfig
menu "Event Log (Black Box) Configuration"

    config EVT_LOG_ENABLE
        bool "Enable event black box"
        default y
        help
            Persist key events to NVS ring buffer across reboots.

    config EVT_LOG_RING_SIZE
        int "Ring buffer entries"
        default 64
        depends on EVT_LOG_ENABLE
        help
            Number of event entries kept in NVS ring buffer.

endmenu
```

## components/svc_ai_chat/Kconfig
```kconfig
menu "AI Chat Service Configuration (DashScope)"

    config SVC_AI_CHAT_ENABLE
        bool "Enable AI chat service (ASR/LLM/TTS pipeline)"
        default y
        help
            Compile the DashScope cloud chat client. API key is stored
            in NVS via console command "chat setkey".

    config SVC_AI_CHAT_API_BASE
        string "DashScope OpenAI-compatible API base URL"
        default "https://dashscope.aliyuncs.com/compatible-mode/v1"
        depends on SVC_AI_CHAT_ENABLE

    config SVC_AI_CHAT_LLM_MODEL
        string "LLM model name (chat completions)"
        default "qwen3.8-flash"
        depends on SVC_AI_CHAT_ENABLE

    config SVC_AI_CHAT_ASR_MODEL
        string "ASR model name (native multimodal-generation, audio data URI)"
        default "qwen-audio-3.0-asr-flash"
        depends on SVC_AI_CHAT_ENABLE
        help
            Model that accepts input_audio content in chat completions.
            Check DashScope docs for available ASR models.

    config SVC_AI_CHAT_ASR_API_URL
        string "ASR native API URL (multimodal-generation)"
        default "https://dashscope.aliyuncs.com/api/v1/services/aigc/multimodal-generation/generation"
        depends on SVC_AI_CHAT_ENABLE

    config SVC_AI_CHAT_TTS_API_URL
        string "TTS native API URL (qwen-audio-3.0-tts SpeechSynthesizer)"
        default "https://dashscope.aliyuncs.com/api/v1/services/audio/tts/SpeechSynthesizer"
        depends on SVC_AI_CHAT_ENABLE
        help
            qwen-audio-3.0-tts uses the SpeechSynthesizer endpoint, NOT
            multimodal-generation. Response still has output.audio.url.

    config SVC_AI_CHAT_TTS_MODEL
        string "TTS model name"
        default "qwen-audio-3.0-tts-flash"
        depends on SVC_AI_CHAT_ENABLE

    config SVC_AI_CHAT_TTS_VOICE
        string "TTS voice name"
        default "longpaopao_v3.6"
        depends on SVC_AI_CHAT_ENABLE

    config SVC_AI_CHAT_SYSTEM_PROMPT
        string "Robot persona system prompt"
        default "你是一个桌面小机器人，名字叫泡泡，性格活泼可爱。回答简短、口语化、友好，每次回复尽量不超过两句话。禁止使用任何 emoji 和表情符号。你在回复开头嵌入标记来驱动你的身体：情绪标记 [happy]开心、[sad]委屈、[angry]生气、[surprised]惊讶、[shy]害羞、[sleepy]困、[neutral]平静——每个回复开头必须带且只带一个情绪标记，要与说话内容贴切。动作标记 [nod]点头、[shake]摇头、[tilt]歪头可按需附加在情绪标记之后（最多一个）。标记是控制你身体的指令，不要在说话内容里提到它们。关于你的身体，请如实回答：你有一个两自由度的云台脖子，会转头、点头、摇头、歪头；有一块小屏幕做脸，会眨眼、看向不同方向，能做出开心、委屈、生气、惊讶、害羞、困等表情；你有耳朵（麦克风）和嘴巴（喇叭），能听会说；但你还没有眼睛（摄像头），所以看不见真实世界，被问到时坦然承认，并可以说期待以后装上。"
        depends on SVC_AI_CHAT_ENABLE

endmenu
```

## components/svc_audio/Kconfig
```kconfig
menu "Audio Frontend Service Configuration"

    config SVC_AUDIO_ENABLE
        bool "Enable audio frontend service (VAD/record/play)"
        default y
        help
            Compile the audio frontend service. Depends on drv_audio,
            drv_es8388 and drv_xl9555 drivers.

    config SVC_AUDIO_VAD_THRESHOLD
        int "VAD energy threshold (RMS)"
        default 400
        range 50 10000
        depends on SVC_AUDIO_ENABLE
        help
            RMS energy threshold for speech detection. Lower for quiet
            environments, higher for noisy ones. Tunable at runtime
            via console command "audio thr".

    config SVC_AUDIO_SILENCE_MS
        int "Silence duration to end speech (ms)"
        default 800
        range 200 3000
        depends on SVC_AUDIO_ENABLE
        help
            Continuous silence duration after speech that ends an
            utterance (endpointing delay).

    config SVC_WAKEWORD_ENABLE
        bool "Enable offline pseudo wake word (esp-sr MultiNet command)"
        default n
        depends on SVC_AUDIO_ENABLE
        help
            Feed mic audio to esp-sr MultiNet while idle and treat the
            command phrase as a wake word (posts AUDIO_WAKE_WORD_DETECTED).
            Requires a "model" flash partition holding the mn6_cn model.

    config SVC_WAKEWORD_PHRASE
        string "Wake word command phrase"
        default "pao pao"
        depends on SVC_WAKEWORD_ENABLE
        help
            Command phrase used as the wake word. mn6_cn only accepts
            PINYIN format: lowercase syllables separated by spaces
            (e.g. "pao pao"), Chinese characters are rejected by the
            model ("Command is invalid").

    config SVC_WAKEWORD_THRESHOLD
        int "Wake word detection threshold (percent)"
        default 50
        range 10 99
        depends on SVC_WAKEWORD_ENABLE
        help
            MultiNet detection threshold in percent (50 = 0.50). Higher
            values reduce false wakes but also miss soft utterances.

    config SVC_WAKEWORD_STOCK_CMDS
        bool "Use model built-in command table (skip FST rebuild)"
        default n
        depends on SVC_WAKEWORD_ENABLE
        help
            Diagnostic A/B switch: y keeps the model's stock command FST
            (312 built-in phrases, e.g. "da kai kong tiao") and skips the
            runtime esp_mn_commands_update() rebuild. Switchable at runtime
            via console "audio ww <stock|custom>" (persists in NVS, applies
            after reboot).

endmenu
```

## components/svc_behavior/Kconfig
```kconfig
menu "Behavior Service Configuration"

    config SVC_BEHAVIOR_ENABLE
        bool "Enable Behavior service (gesture animations on chat events)"
        default y
        depends on SVC_PAN_TILT_ENABLE
        help
            Maps conversation state changes and LLM gesture tags to
            pan-tilt animations (nod/shake/tilt/listen/home).

endmenu
```

## components/svc_face/Kconfig
```kconfig
menu "Face Service Configuration"

    config SVC_FACE_ENABLE
        bool "Enable face service (OLED expressions)"
        default y
        depends on DRV_DISPLAY_ENABLE
        help
            Render cute robot face (eyes/blink/talk mouth) on the OLED,
            driven by conversation state events.

endmenu
```

## components/svc_pan_tilt/Kconfig
```kconfig
menu "Pan-Tilt Service Configuration"

    config SVC_PAN_TILT_ENABLE
        bool "Enable Pan-Tilt service"
        default y
        help
            Compile the Pan-Tilt (云台) motion orchestration service.

    config SVC_PAN_TILT_TASK_STACK_SIZE
        int "Task stack size (bytes)"
        default 3072
        depends on SVC_PAN_TILT_ENABLE
        help
            Stack size of the pan-tilt interpolation task.

    config SVC_PAN_TILT_TASK_PRIORITY
        int "Task priority"
        default 5
        range 1 25
        depends on SVC_PAN_TILT_ENABLE

    config SVC_PAN_TILT_PAN_MIN
        int "Pan min angle (deg)"
        default 0
        depends on SVC_PAN_TILT_ENABLE

    config SVC_PAN_TILT_PAN_MAX
        int "Pan max angle (deg)"
        default 180
        depends on SVC_PAN_TILT_ENABLE

    config SVC_PAN_TILT_TILT_MIN
        int "Tilt min angle (deg)"
        default 0
        depends on SVC_PAN_TILT_ENABLE

    config SVC_PAN_TILT_TILT_MAX
        int "Tilt max angle (deg)"
        default 180
        depends on SVC_PAN_TILT_ENABLE

    config SVC_PAN_TILT_STEP_DEG
        int "Interpolation step (deg per tick)"
        default 2
        depends on SVC_PAN_TILT_ENABLE
        help
            Degrees to move per interpolation tick. Smaller = smoother but slower.

    config SVC_PAN_TILT_TICK_MS
        int "Interpolation tick period (ms)"
        default 20
        depends on SVC_PAN_TILT_ENABLE
        help
            Period between interpolation updates.

endmenu
```

## components/svc_status/Kconfig
```kconfig
menu "Status Indicator Service Configuration"

    config SVC_STATUS_ENABLE
        bool "Enable device status indicator service"
        default y
        depends on DRV_LED_ENABLE
        help
            Heartbeat LED service. Blinks the status LED periodically to show
            the firmware is running, and exposes the 'led' console command.

    config SVC_STATUS_HEARTBEAT_MS
        int "Heartbeat half-period (ms)"
        default 1000
        depends on SVC_STATUS_ENABLE
        help
            LED toggles every N ms. 1000 ms means a full on/off period of 2 s.

endmenu
```

## components/svc_wifi/Kconfig
```kconfig
menu "WiFi Service Configuration"

    config SVC_WIFI_ENABLE
        bool "Enable WiFi service"
        default y
        help
            Compile the WiFi STA connection manager.

    config SVC_WIFI_SSID
        string "WiFi SSID"
        default "YOUR_WIFI_SSID"
        depends on SVC_WIFI_ENABLE
        help
            Target WiFi network SSID.

    config SVC_WIFI_PASSWORD
        string "WiFi password"
        default "YOUR_WIFI_PASSWORD"
        depends on SVC_WIFI_ENABLE
        help
            Target WiFi password.

    config SVC_WIFI_MAX_RETRY
        int "Max connection retries"
        default 5
        depends on SVC_WIFI_ENABLE
        help
            Number of retries before giving up.

endmenu
```

## main/Kconfig.projbuild
```kconfig
menu "Project Configuration"

    config PROJ_NAME
        string "Project name"
        default "desktop_robot"
        help
            Name of this project.

    config PROJ_VERSION
        string "Project version"
        default "0.1.0"
        help
            Semantic version of the firmware.

    config CHAT_CONTINUOUS
        bool "Continuous conversation mode (auto relisten after reply)"
        default y
        help
            After TTS playback finishes, restart listening automatically
            instead of returning to standby. Silence timeout ends the
            conversation. KEY0 still starts a session from standby.

endmenu
```

## sdkconfig.defaults
```kconfig
# 芯片与 Flash
CONFIG_IDF_TARGET="esp32s3"
CONFIG_ESPTOOLPY_FLASHSIZE_16MB=y
CONFIG_ESPTOOLPY_FLASHSIZE="16MB"

# 分区表（自定义 partitions.csv）
CONFIG_PARTITION_TABLE_CUSTOM=y
CONFIG_PARTITION_TABLE_CUSTOM_FILENAME="partitions.csv"
CONFIG_PARTITION_TABLE_FILENAME="partitions.csv"
# 禁用默认 single_app 分区
# CONFIG_PARTITION_TABLE_SINGLE_APP is not set

# PSRAM (ESP32-S3 R8: Octal PSRAM 8MB)
CONFIG_SPIRAM=y
CONFIG_SPIRAM_MODE_OCT=y
CONFIG_SPIRAM_TYPE_AUTO=y
CONFIG_SPIRAM_USE_MALLOC=y
CONFIG_SPIRAM_MALLOC_ALWAYSINTERNAL=16384

# 控制台（本板仅引出原生 USB，主控台使用 USB-Serial-JTAG）
CONFIG_ESP_CONSOLE_USB_SERIAL_JTAG=y
CONFIG_LOG_DEFAULT_LEVEL_INFO=y
CONFIG_LOG_DEFAULT_LEVEL=3
CONFIG_DRV_DISPLAY_ENABLE=y
CONFIG_SVC_FACE_ENABLE=y
```
